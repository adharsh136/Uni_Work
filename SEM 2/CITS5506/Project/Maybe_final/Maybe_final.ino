//All modules required to run the program
#include <WiFi.h>
#include <Wire.h>
#include <Adafruit_GFX.h>
#include <Adafruit_SSD1306.h>
#include <ThingSpeak.h>
#include "HX711.h"
//-------------------------------------------------------------------------------------------------------------------------
#define LOADCELL_DOUT_PIN  35 //HX711 DT PIN
#define LOADCELL_SCK_PIN  15 // HX711 SCK Pin
#define CHANNEL_ID1 2286761 //Write Channel ID
#define CHANNEL_ID2 2287107 //Read Channel ID
#define CHANNEL_WRITE_API_KEY "EPBNJOD1B8ZXNTRM" //API key for write channel
#define CHANNEL_READ_API_KEY "Q682151FXCS2RFOY" //API key for read channel
#define calibration_factor 211000 // Calibration factor for the selected load cell
#define zero_factor 193373 //Offset value for the selected load cell
#define WIFI_NETWORK "Adharsh" //Mobile phone hotspot name(SSID)
#define WIFI_PASSWORD "oiky2507" //Mobile phone hotspot password
#define WIFI_TIMEOUT_MS 10000 //U dont want ESP32 to keep trying to connect infinitely in case the name and password dont match, or if the network is not available.
#define SCREEN_WIDTH 128 // OLED display width, in pixels
#define SCREEN_HEIGHT 64 // OLED display height, in pixels
#define micS_to_S_Factor 1000000
#define time_to_sleep 10 //10 seconds sleep (After every data transmission) or (when the bag is being changed)
//-------------------------------------------------------------------------------------------------------------------------
WiFiClient client; //WiFiClient object
HX711 scale; //HX711 object
Adafruit_SSD1306 display(SCREEN_WIDTH, SCREEN_HEIGHT, &Wire, -1); //SSD1306 object
//-------------------------------------------------------------------------------------------------------------------------
float weight; //Global weight variable that holds the weight data
int digital_button = 0; //Global variable that holds the data from ThingSpeak generated by the user through the Application
static const uint8_t image_data_Image[1024] = {           
  0xff, 0xff, 0xff, 0xff, 0xff, 0xff, 0xff, 0xff, 0xff, 0xff, 0xff, 0xff, 0xff, 0xff, 0xff, 0xff, 
    0xff, 0xff, 0xff, 0xff, 0xff, 0xff, 0xff, 0xff, 0xff, 0xff, 0xff, 0xff, 0xff, 0xff, 0xff, 0xff, 
    0xff, 0xff, 0xff, 0xff, 0xff, 0xff, 0xff, 0xff, 0xff, 0xff, 0xff, 0xff, 0xff, 0xff, 0xff, 0xff, 
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    0xff, 0x00, 0x00, 0x00, 0x00, 0x00, 0x00, 0x00, 0x00, 0x00, 0x00, 0x00, 0x00, 0x00, 0x00, 0x00
}; //128x64 monochrome image (caution symbol) information stored in an array (Block-size:8bit) (Byte-order:Little-eldian)
//-------------------------------------------------------------------------------------------------------------------------
// Function that connects the ESP-32E to Wi-Fi
void connectToWiFi(){
  Serial.print("Connecting to Wifi");
  WiFi.mode(WIFI_STA); //Station mode, to connect to available networks
  WiFi.begin(WIFI_NETWORK,WIFI_PASSWORD); //try to connect to the specified wifi SSID

  unsigned long startAttemptTime = millis(); //millis() function returns the current uptime of the ESP32

  while(WiFi.status() != WL_CONNECTED && millis() - startAttemptTime < WIFI_TIMEOUT_MS){ //try for 10 seconds
    Serial.print(".");
    delay(100);
  }
  if(WiFi.status() != WL_CONNECTED){ // The case if failed to connect, try again.
                                    // Displaying appropriate messages in the 128x64 OLED display
  Serial.println("Failed to connect to the network!");
  Serial.println("Trying again");
  display.clearDisplay();
  display.setTextSize(2);
  display.setTextColor(WHITE);
  display.setCursor(0,0);
  display.println("Not connected");
  display.println();
  display.println("to Wi-Fi!");
  display.display();
  delay(1000);
  display.clearDisplay();
  display.setTextColor(WHITE);
  display.setCursor(0,0);
  display.println("Trying");
  display.println();
  display.println("again!");
  display.display();
  connectToWiFi(); //calling the function again to try again
  }
  else{ // The case if successfully connected.
        // Displaying appropriate messages in the 128x64 OLED display
  Serial.println("Connected to the network!");
  display.clearDisplay();
  display.setTextSize(2);
  display.setTextColor(WHITE);
  display.setCursor(0,0);
  display.println("   Wi-Fi");
  display.println();
  display.println("connected!");
  display.display();
  Serial.println(WiFi.localIP()); //displays the IP of the connected network
  }
}
//-------------------------------------------------------------------------------------------------------------------------
// Function that measures weight and controls the display under different scenarios
void measureweight(){
  weight = scale.get_units(); //Function that returns analog data converted to human understandable form.
    if(weight<0)              //If the wheatstone bridge thats supposed to experience compression undergoes expansion and vice versa,
                              //we get a negative value, to avoid this we implement this condition
  {
    weight=0.00;
    }
    //Displaying weight data in the serial monitor
  Serial.print("Kilogram:");
  Serial.print( weight); 
  Serial.print(" Kg");
  Serial.println();

  if(digital_button == 0){  //If we get no input data from ThingSpeak, it means that connection is load between the server and the APP or the server and the ESP-32E, 
                            // this case displays that information. On the 128x64 OLED display, "Connection lost!" message is displayed
    display.clearDisplay();
    display.setTextSize(2);
    display.setTextColor(WHITE);
    display.setCursor(0,0);
    display.println("Connection");
    display.println();
    display.println("  lost! ");
    display.display();
  }
  else if(digital_button == 1) // We get a value of one from the server if the User wants to stop measuring the weight and change the saline/IV bag,
                              // this case corresponds to this scenario. On the 128x64 OLED display, "Changing bag!" message is displayed
  {
    display.clearDisplay();
    display.setTextSize(2);
    display.setTextColor(WHITE);
    display.setCursor(0,0);
    display.println("Changing");
    display.println();
    display.println("  bag! ");
    display.display();
    delay(1000);
  }
  else if(weight<0.3 and digital_button == 2){ //This case is when the saline/IV bag goes to low level and a notification is to be sent to the user
                                              //Notice that the digital_button value is 2, which means the user wants the weight to be measured.
                                              //We have set the threshold weight to be 300 grams, anything less and the user is notified.
                                              //This case only displays an alert in the 128x64 OLED display and not in the app, the notification/alert that the user gets is through the app's logic.
                                              //On the 128x64 OLED display,a CAUTION SYMBOL followed by "Fluid level low!" message are displayed.
    display.clearDisplay();
    display.drawBitmap(0, 0, image_data_Image, 128, 64, 1);
    display.display();
    delay(1500);
    display.clearDisplay();
    display.setTextSize(2);
    display.setTextColor(WHITE);
    display.setCursor(0,0);
    display.println("  Fluid  ");
    display.println();
    display.println("level low!");
    display.display();
  }
  else{                         //This case is when the weight is above the threshold and the user just wants to measure the weight.
                                //It just displays the weight data in the 128x64 OLED display.
                                //Interestingly, this is the case that gets executed under normal use.
  display.clearDisplay();
  display.setTextSize(2);
  display.setTextColor(WHITE);
  display.setCursor(0,0);
  display.print("Weight: ");
  display.setTextSize(3);
  display.setCursor(0, 20);
  display.print(weight);
  display.print(" kg");
  display.display();
  }
  delay(500);    //A small delay is required for the load cell and HX711 to function properly.
                //This acts as a delay between consecutive measurements.
}
//-------------------------------------------------------------------------------------------------------------------------
//Function that puts the ESP-32E to deep sleep after transmitting data successfully.
//All the time when the ESP-32E is in deep sleep, "Sleeping!" is displayed on the 128x64 OLED. 
//This helps with knowing the state of the microcontroller.
void sleep_after_transmission(){
  Serial.println("Sleeping after sending data!"); 
  display.clearDisplay();
  display.setTextSize(2);
  display.setTextColor(WHITE);
  display.setCursor(0,0);
  display.println("Sleeping!");
  display.display();
  delay(1500);
  esp_sleep_enable_timer_wakeup(time_to_sleep*micS_to_S_Factor); //In-built function that calculates the amount of time the ESP-32E needs to sleep.
  esp_deep_sleep_start(); //In-built function that puts the ESP-32E to sleep for the calculated amount of time.
}
//-------------------------------------------------------------------------------------------------------------------------
//Function that puts the ESP-32E to deep sleep while the bag is being changed.
//All the time when the ESP-32E is in deep sleep, "Sleeping!" is displayed on the 128x64 OLED. 
//This helps with knowing the state of the microcontroller.
void sleep_while_changing_bag(){
  Serial.println("Sleeping until bag is changed!");
  display.clearDisplay();
  display.setTextSize(2);
  display.setTextColor(WHITE);
  display.setCursor(0,0);
  display.println("Sleeping!");
  display.display();
  delay(1500);
  esp_sleep_enable_timer_wakeup(time_to_sleep*micS_to_S_Factor); //In-built function that calculates the amount of time the ESP-32E needs to sleep.
  esp_deep_sleep_start(); //In-built function that puts the ESP-32E to sleep for the calculated amount of time.
}
//-------------------------------------------------------------------------------------------------------------------------
// Function that is used to setup all the components and begin their functionality if required.
void setup() {
  //Specifying I2C address for the 128x64 OLED display.
  if(!display.begin(SSD1306_SWITCHCAPVCC, 0x3C)) { 
    Serial.println(F("SSD1306 allocation failed"));
    for(;;);
  }
  delay(2000); // Delay for the display to configure.

  Serial.begin(9600); //Start serial monitor at baud rate = 9600

  connectToWiFi(); //Function call that helps with getting connected to the Wi-Fi.
  ThingSpeak.begin(client); //Function call that helps with connecting to the ThingSpeak server with the help of the connected Wi-Fi network.

  scale.begin(LOADCELL_DOUT_PIN, LOADCELL_SCK_PIN); //Setting up the load cell and the HX711 at pins 35(DT) and 15(SCK)
  scale.set_scale(calibration_factor); //Setting the calibration factor, found by calibirating the load cell and HX711.
  scale.set_offset(zero_factor); //Setting the zero factor or the scale offset value, this is also found during calibration. This helps with applications that need weight to be monitored continuously.
}
//-------------------------------------------------------------------------------------------------------------------------
//Function that runs repeatedly.
void loop() {
  digital_button = ThingSpeak.readIntField(CHANNEL_ID2,3,CHANNEL_READ_API_KEY); //Reading value from ThingSpeak server, generated by the user. (the function returns 0 if failed to retrieve data)

  measureweight(); //Function call to measureweight();

  ThingSpeak.setField(1,weight); //Setting field1 value as weight data in ThingSpeak
  ThingSpeak.setField(2,WiFi.RSSI()); //Setting field2 value as Wi-Fi signal strength data in ThingSpeak

  Serial.println(digital_button); //Printing the digital_button value to serial monitor, useful to understand the workflow/debugging.

  if(digital_button == 2 || digital_button == 1){ //Only if digital_button values is either 1 or 2, we write the data to ThingSpeak server.
  ThingSpeak.writeFields(CHANNEL_ID1, CHANNEL_WRITE_API_KEY); //Function that writes the set field values to the server given the channel name and write API key.
  }

  if(digital_button != 0){ //ESP-32E goes to sleep only if it successfully transmits the weight data.
                          // If not connected to the server, it waits until the connection is re-established.
    if(digital_button == 1){
      delay(1000);
      sleep_while_changing_bag(); //Sleep during the change of bag.
    }
    else{
      delay(1000);
    sleep_after_transmission(); //Sleep after successfully transmitting data.
    }
  }
}
