#include <WiFi.h>
#include <Wire.h>
#include <Adafruit_GFX.h>
#include <Adafruit_SSD1306.h>
#include <ThingSpeak.h>
#include "HX711.h"

#define LOADCELL_DOUT_PIN  35
#define LOADCELL_SCK_PIN  15
#define CHANNEL_ID1 2286761
#define CHANNEL_ID2 2287107
#define CHANNEL_WRITE_API_KEY "EPBNJOD1B8ZXNTRM"
#define CHANNEL_READ_API_KEY "Q682151FXCS2RFOY"
#define calibration_factor 211000 // for me this value works
#define WIFI_NETWORK "Adharsh"
#define WIFI_PASSWORD "oiky2507"
#define WIFI_TIMEOUT_MS 20000 //U dont want ESP32 to keep trying to connect in case the name and password dont match
#define SCREEN_WIDTH 128 // OLED display width, in pixels
#define SCREEN_HEIGHT 64 // OLED display height, in pixels

WiFiClient client;
HX711 scale;
Adafruit_SSD1306 display(SCREEN_WIDTH, SCREEN_HEIGHT, &Wire, -1);

float weight; 
int flag = 0;
int digital_button = 0; 

static const uint8_t image_data_Image[1024] = {
  0xff, 0xff, 0xff, 0xff, 0xff, 0xff, 0xff, 0xff, 0xff, 0xff, 0xff, 0xff, 0xff, 0xff, 0xff, 0xff, 
    0xff, 0xff, 0xff, 0xff, 0xff, 0xff, 0xff, 0xff, 0xff, 0xff, 0xff, 0xff, 0xff, 0xff, 0xff, 0xff, 
    0xff, 0xff, 0xff, 0xff, 0xff, 0xff, 0xff, 0xff, 0xff, 0xff, 0xff, 0xff, 0xff, 0xff, 0xff, 0xff, 
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    0xff, 0x00, 0x00, 0x00, 0x00, 0x00, 0x00, 0x00, 0x00, 0x00, 0x00, 0x00, 0x00, 0x00, 0x00, 0x00
};

//-------------------------------------------------------------------------------------------------------------------------
void connectToWiFi(){
  Serial.print("Connecting to Wifi");
  WiFi.mode(WIFI_STA);
  WiFi.begin(WIFI_NETWORK,WIFI_PASSWORD);

  unsigned long startAttemptTime = millis();

  //millis() function returns the uptime of the ESP32

  while(WiFi.status() != WL_CONNECTED && millis() - startAttemptTime < WIFI_TIMEOUT_MS){
    Serial.print(".");
    delay(100);
  }

  if(WiFi.status() != WL_CONNECTED){
  Serial.println("Failed to connect to the network!");
  }
  else{
  Serial.println("Connected to the network!");
  Serial.println(WiFi.localIP());
  }
}
//-------------------------------------------------------------------------------------------------------------------------
void measureweight(){
  weight = scale.get_units(); 
    if(weight<0)
  {
    weight=0.00;
    }
  //Serial.print(scale.get_units(), 2);
  Serial.print("Kilogram:");
  Serial.print( weight); 
  Serial.print(" Kg");
  Serial.println();
  if(digital_button == 0){
    display.clearDisplay();
    display.setTextSize(2);
    display.setTextColor(WHITE);
    display.setCursor(0,0);
    display.println("Connection");
    display.println();
    display.println("  lost! ");
    display.display();
  }
  else if(weight<0.3 and digital_button == 1)
  {
    display.clearDisplay();
    display.setTextSize(2);
    display.setTextColor(WHITE);
    display.setCursor(0,0);
    display.println("Changing");
    display.println();
    display.println("  bag! ");
    display.display();
    delay(1000);
    display.clearDisplay();
    display.setTextSize(2);
    display.setTextColor(WHITE);
    display.setCursor(0,0);
    display.println("  Please  ");
    display.println();
    display.println("  wait! ");
    display.display();
    
  }
  else if(weight<0.3 and digital_button == 2){
    display.clearDisplay();
    display.setTextSize(2);
    display.setTextColor(WHITE);
    display.setCursor(0,0);
    display.println("  Fluid  ");
    display.println();
    display.println("level low!");
    display.display();
    delay(1000);
    display.clearDisplay();
    display.drawBitmap(0, 0, image_data_Image, 128, 64, 1);
    display.display();
    
  }
  else{
  display.clearDisplay();
  display.setTextSize(2);
  display.setTextColor(WHITE);
  display.setCursor(0,0);
  display.print("Weight: ");
  display.setTextSize(3);
  display.setCursor(0, 20);
  display.print(weight);
  display.print(" kg");
  display.display();
 
  }
   delay(500);
}
//-------------------------------------------------------------------------------------------------------------------------
void setup() {
  // put your setup code here, to run once:
  if(!display.begin(SSD1306_SWITCHCAPVCC, 0x3C)) { // Address 0x3D for 128x64
    Serial.println(F("SSD1306 allocation failed"));
    for(;;);
  }
  delay(2000);
  Serial.begin(9600);
  connectToWiFi();
  ThingSpeak.begin(client);
  Serial.println("HX711 scale");
  
  scale.begin(LOADCELL_DOUT_PIN, LOADCELL_SCK_PIN);
  scale.set_scale(calibration_factor);
  scale.tare(); //Reset the scale to 0
  Serial.println("Readings:");
}
//-------------------------------------------------------------------------------------------------------------------------
void loop() {
  // put your main code here, to run repeatedly:
  digital_button = ThingSpeak.readIntField(CHANNEL_ID2,3,CHANNEL_READ_API_KEY);
  measureweight();
  ThingSpeak.setField(1,weight);
  ThingSpeak.setField(2,WiFi.RSSI());
  Serial.println(digital_button);
  ThingSpeak.writeFields(CHANNEL_ID1, CHANNEL_WRITE_API_KEY);

}
